#include "Serial.h"
#include "arm_const_structs.h"
#include "arm_math.h"


const float hanning_1024[] =
{
    0.000009, 0.000038, 0.000085, 0.000150, 0.000235, 0.000338, 0.000460, 0.000601, 0.000761, 0.000939, 0.001136, 0.001352, 0.001587, 0.001840, 0.002112, 0.002403,
    0.002712, 0.003041, 0.003387, 0.003753, 0.004137, 0.004540, 0.004961, 0.005401, 0.005860, 0.006337, 0.006833, 0.007347, 0.007880, 0.008431, 0.009001, 0.009589,
    0.010195, 0.010820, 0.011464, 0.012125, 0.012805, 0.013504, 0.014220, 0.014955, 0.015708, 0.016480, 0.017269, 0.018077, 0.018903, 0.019746, 0.020608, 0.021488,
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    0.002403, 0.002112, 0.001840, 0.001587, 0.001352, 0.001136, 0.000939, 0.000761, 0.000601, 0.000460, 0.000338, 0.000235, 0.000150, 0.000085, 0.000038, 0.000009,
};

#define FFT_LEN 1024

uint32_t Fs = 400000;
uint16_t i;

float FFT_input[FFT_LEN * 2];
float FFT_output[FFT_LEN];

float base_wave_freq;
uint16_t base_wave_freq_index;
uint16_t base_wave_freq_int;
float base_wave_phase;



uint16_t max;
uint16_t min;
uint16_t Vpp;
uint16_t Vdc;
float THD;

float find_peak_mag(uint16_t center_index, uint8_t search_radius) 
{
   
    uint16_t start_idx = (center_index > search_radius) ? 
                         (center_index - search_radius) : 0;
    
    uint16_t end_idx = ((center_index + search_radius) < (FFT_LEN / 2)) ? 
                       (center_index + search_radius) : (FFT_LEN / 2 - 1);
    
    
    float max_mag = 0.0f;
    for ( i = start_idx; i <= end_idx; i++) {
        if (FFT_output[i] > max_mag) {
            max_mag = FFT_output[i];
        }
    }
    
    return max_mag;
}


void get_base_wave(void)
{
    float Max_Val=0;
    
	for(uint16_t i=3;i < FFT_LEN/2;i++)
	{
		if(FFT_output[i] > Max_Val)
		{
			Max_Val = FFT_output[i];
			base_wave_freq_index = i;
		}
	}
	base_wave_freq = (float) Fs / FFT_LEN * base_wave_freq_index ;
}




void FFT(uint16_t * ad_source)
{
	
    for ( i = 0; i < FFT_LEN; i++)
    {
        FFT_input[2*i] = (float)ad_source[i]* hanning_1024[i];
        FFT_input[2*i + 1] = 0;
    }
    arm_cfft_f32(&arm_cfft_sR_f32_len1024, FFT_input, 0, 1);
	arm_cmplx_mag_f32(FFT_input,FFT_output,FFT_LEN);
    // for ( i = 0; i < 512; i++)
    // {
    //     Serial_Printf("%.2f,%d\n",FFT_output[i],i);
    // }

}
void FFT_single_wave(uint16_t * ad_source)
{

    
    for ( i = 0; i < FFT_LEN; i++)
    {
        FFT_input[2*i] = (float)ad_source[i] * hanning_1024[i];
        FFT_input[2*i + 1] = 0;
    }
    arm_cfft_f32(&arm_cfft_sR_f32_len1024, FFT_input, 0, 1);
	arm_cmplx_mag_f32(FFT_input,FFT_output,FFT_LEN);
    // for ( i = 0; i < 512; i++)
    // {
    //     Serial_Printf("%.2f,%d\n",FFT_output[i],i);
    // }


    get_base_wave();
    //get_THD();
    
	//base_wave_phase = atan2(FFT_input[2*base_wave_freq_index + 1],FFT_input[2*base_wave_freq_index]) * 180 / PI;
    
}

void getVpp(uint16_t * ad_source)
{
     max = 0;
     min = 4099;
    for (i = 1; i < FFT_LEN; i++)
	{
		if (ad_source[i] > max)
			max = ad_source[i];
           // Serial_Printf("max:%d,ad:%d\n\r\n",max,ad_source[i]);
		if (ad_source[i] < min)
			min = ad_source[i];
	}
    
    
	Vpp = (float)(max - min) / 4095 * 3300;
    Vdc = (float)((max + min)/2) / 4095 * 3300;
    //Serial_Printf("max:%d,min:%d,Vpp:%d\n\r\n",max,min,Vpp);
}
